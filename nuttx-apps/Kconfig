## nuttx-apps/arduinoTMC/Kconfig
```kconfig
#
# For a description of the syntax of this configuration file,
# see the file kconfig-language.txt in the NuttX tools repository.
#

config ARDUINO_TMC
	tristate "Arduino TMC Driver Implementation"
	default n
	---help---
		Enable the Arduino TMC Driver Implementation

if ARDUINO_TMC

endif
```

## nuttx-apps/echo_serial/Kconfig
```kconfig
#
# For a description of the syntax of this configuration file,
# see the file kconfig-language.txt in the NuttX tools repository.
#

config ECHO_SERIAL
	tristate "Echo Serial"
	default n
	---help---
		Enable the Echo Serial example

if ECHO_SERIAL
	config ECHO_SERIALRX_DEVPATH
		string "Serial device path"
		default "/dev/ttyS4"
		---help---
			The default path to the serial device

	config ECHO_SERIALRX_BUFSIZE
	int "Buffer size"
	default 11520
	---help---
		Specifies the default buffer size
endif
```

## nuttx-apps/examples/keybpwm/Kconfig
```kconfig
#
# For a description of the syntax of this configuration file,
# see the file kconfig-language.txt in the NuttX tools repository.
#

config EXAMPLES_KEYBPWM
	tristate "KEYB PWM"
	default n
	depends on PWM
	---help---
		Enable the Pulse width modulation (PWM) example

if EXAMPLES_KEYBPWM

config EXAMPLES_KEYBPWM_DEVPATH
	string "PWM device path"
	default "/dev/pwm1"
	---help---
		The path to the PWM device.  Default: /dev/pwm1

config EXAMPLES_KEYBPWM_FREQUENCY
	int "Default PWM frequency"
	default 50
	---help---
		The default PWM frequency.  Default: 50 Hz

config EXAMPLES_KEYBPWM_DURATION
	int "Default PWM duration"
	default 5
	---help---
		The default PWM pulse train duration in seconds.  Used only if the current
		pulse count is zero (pulse count is only supported if PWM_PULSECOUNT
		is not defined).  Default: 5 seconds

config EXAMPLES_KEYBPWM_DUTYPCT
	int "Default PWM duty percentage"
	default 5
	range 1 99
	---help---
		The default PWM duty as a percentage.  Default: 5%

endif
```

## nuttx-apps/examples/sandbox/Kconfig
```kconfig
#
# For a description of the syntax of this configuration file,
# see the file kconfig-language.txt in the NuttX tools repository.
#

config EXAMPLES_SANDBOX
	tristate "PWM::Sandbox to test pieces of code."
	default n
	---help---
		Enable Unlimited PWM

if EXAMPLES_SANDBOX

config EXAMPLES_SANDBOX_PROGNAME
	string "Program name"
	default "sandbox"
	---help---
		This is the name of the program that will be used when the NSH ELF
		program is installed.

config EXAMPLES_SANDBOX_PRIORITY
	int "Sandbox task priority"
	default 100

config EXAMPLES_SANDBOX_STACKSIZE
	int "Sandbox stack size"
	default DEFAULT_TASK_STACKSIZE

endif
```

## nuttx-apps/gpio_biba/Kconfig
```kconfig
#
# For a description of the syntax of this configuration file,
# see the file kconfig-language.txt in the NuttX tools repository.
#

config GPIO_BITBANG
	tristate "GPIO_BITBANG example"
	default n
	---help---
		Enable the GPIO_BITBANG example

if GPIO_BITBANG

endif
```

## nuttx-apps/qcomamr/Kconfig
```kconfig
config APP_QCOMAMR
    tristate "Qualcomm AMR application"
    default n
    ---help---
        Enable QC AMR application

config APP_QCOMAMR_DXO
    tristate "Qualcomm AMR DXO application"
    default n

if APP_QCOMAMR

endif
```

## nuttx-apps/starter/Kconfig
```kconfig
#
# For a description of the syntax of this configuration file,
# see the file kconfig-language.txt in the NuttX tools repository.
#

config STARTER
	tristate "Hello World starter"
	default n
	---help---
		Enable the Hello World example

if STARTER

endif
```

## nuttx-apps/tmc2209/Kconfig
```kconfig
#
# For a description of the syntax of this configuration file,
# see the file kconfig-language.txt in the NuttX tools repository.
#

config TMC2209
	tristate "TMC 2209 Driver"
	default n
	---help---
		Enable the Hello World example

if TMC2209
	config TMC2209_DEVPATH
		string "Serial device path"
		default "/dev/ttyS4"
		---help---
			The default path to the serial device

	config TMC2209_BUFSIZE
	int "Buffer size"
	default 11520
	---help---
		Specifies the default buffer size

endif
```
